#include "oled.h"
#include "oledfont.h"
/* Graphic RAM of OLED
 * GRAM[page number][x coordinate]
 */
static u8 GRAM[8][128];

static const float sin_table[361]={0.000000,0.017452,0.034899,0.052336,0.069756,0.087156,0.104528,0.121869,0.139173,0.156434,0.173648,0.190809,0.207912,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-0.017452,0.000000};
static const float cos_table[361]={1.000000,0.999848,0.999391,0.998630,0.997564,0.996195,0.994522,0.992546,0.990268,0.987688,0.984808,0.981627,0.978148,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0.999848,1.000000};

// IIC Write Command
void Write_IIC_Command(u8 IIC_Command)
{
   I2C_SendByte(I2C, 0x3C, 0x00, IIC_Command);
}

// IIC Write Data
void Write_IIC_Data(u8 IIC_Data)
{
   I2C_SendByte(I2C, 0x3C, 0x40, IIC_Data);
}

// OLED Write Byte
void OLED_WR_Byte(u8 dat,u8 cmd)
{
	if(cmd) {
   		Write_IIC_Data(dat);
	}
	else {
   Write_IIC_Command(dat);	
	}
	return;
}

// OLED wtire data
void OLED_WR_Data(u8 *data,u16 data_num){
	I2C_SendData(I2C, 0x3C, 0x40, data, data_num);
}

// OLED draw point
void OLED_DrawPoint(u8 x, u8 y) {
	u8 page_pos = y/8;
	y = y%8;
	if(x<Max_Column&&y<Max_Row)
		GRAM[page_pos][x] |= 1<<y;
	return;
}

// OLED draw line
void OLED_DrawLine(u8 x0, u8 y0, u8 x1, u8 y1) {
	u8 temp, x, y, dx, dy;
	int8_t err, ystep;
	u8 swap=0;

	if ( x0 > x1 ) dx = x0-x1; else dx = x1-x0;
	if ( y0 > y1 ) dy = y0-y1; else dy = y1-y0;
	if ( dy > dx ) {
		swap = 1;
		temp = dx; dx =dy; dy = temp;
		temp = x0; x0 =y0; y0 = temp;
		temp = x1; x1 =y1; y1 = temp;
	}
	if ( x0 > x1 ) {
		temp = x0; x0 =x1; x1 = temp;
		temp = y0; y0 =y1; y1 = temp;
	}
	err = dx >> 1;
	if ( y1 > y0 ) ystep = 1; else ystep = -1;
	y = y0;
	for( x = x0; x <= x1; x++ )
	{
		if ( swap == 0 ) 
			OLED_DrawPoint(x, y); 
		else 
			OLED_DrawPoint(y, x); 
		err -= (u8)dy;
		if ( err < 0 ) {
			y += (u8)ystep;
			err += (u8)dx;
		}
	}
	return;
}

// OLED draw line 
void OLED_DrawLineAngle(u8 x0, u8 y0, u16 angle, u8 len) {
	int8_t xi, yi, i;
	for(i=0; i<len; i++) {
		xi = cos_table[angle]*i;
		yi = sin_table[angle]*i;
		OLED_DrawPoint(x0+xi, y0-yi);
	}
	return;
}

// OLED draw symmetric points on circle
void OLED_DrawCirclePoint(u8 x0, u8 y0, u8 x, u8 y) {
	u8 tmp;
	if(x==x0) {
		OLED_DrawPoint(x, y);
		OLED_DrawPoint(x, 2*y0-y);
		OLED_DrawPoint(x0+y-y0, y0);
		OLED_DrawPoint(x0-(y-y0), y0);
		return;
	}
	OLED_DrawPoint(x, y);
	OLED_DrawPoint(2*x0-x, y);
	OLED_DrawPoint(x, 2*y0-y);
	OLED_DrawPoint(2*x0-x, 2*y0-y);
	tmp=x0+y-y0;
	y=y0+x-x0;
	x=tmp;
	OLED_DrawPoint(x, y);
	OLED_DrawPoint(2*x0-x, y);
	OLED_DrawPoint(x, 2*y0-y);
	OLED_DrawPoint(2*x0-x, 2*y0-y);
	return;
}

//OLED draw circle
void OLED_DrawCircle(u8 x0, u8 y0, u8 r) {
	u8 xi, yi, xlimit;
	int delta1, delta2;
	xi = x0; yi = y0+r;
	xlimit = x0+r*3/4;
	OLED_DrawCirclePoint(x0, y0, xi, yi);
	while(xi <= xlimit) {
		delta1 = (yi-y0-1)*(yi-y0-1) + (xi-x0+1)*(xi-x0+1) - r*r;
		if(delta1 < 0) {
			delta2 = 2*(delta1+yi-y0)-1;
			if(delta2 <= 0) {
				OLED_DrawCirclePoint(x0, y0, xi+1, yi);
				xi++;
				continue;
			}
			else {
				OLED_DrawCirclePoint(x0, y0, xi+1, yi-1);
				xi++;
				yi--;
				continue;
			}
		}
		else if(delta1>0) {
			delta2 = 2*(delta1-(xi-x0))-1;
			if(delta2 <= 0) {
				OLED_DrawCirclePoint(x0, y0, xi+1, yi-1);
				xi++;
				yi--;
				continue;
			}
			else {
				OLED_DrawCirclePoint(x0, y0, xi, yi-1);
				yi--;
				continue;
			}
		}
		else {
				OLED_DrawCirclePoint(x0, y0, xi+1, yi-1);
				xi++;
				yi--;
				continue;
		}
	}
	return;
}

// OLED draw character
void OLED_DrawChar(u8 x,u8 y,char ch) {      	
	u8 c, i;	
	c=ch-' ';
	if(x<Max_Column-6&&y<8) {
		for(i=0;i<6;i++)
			GRAM[y][x+i] = F6x8[c][i];
	}
	return;
}

// OLED draw string
void OLED_DrawString(u8 x, u8 y, char *string) {
	u8 i, xi;
	i = 0; xi = x;
	while(string[i] != '\0') {
		OLED_DrawChar(xi, y, string[i]);
		i++;
		xi += 7;
	}
	return;
}

void OLED_ClearGRAM(void){
	u8 page, column;
	for(page=0;page<8;page++)
		for(column=0;column<128;column++)
			GRAM[page][column] = 0;
	return;
}

// OLED write frame
void OLED_WriteFrame(void) {
	u8 page;
	for(page=0;page<8;page++)
	{
		OLED_WR_Byte(0xb0+page,0);		//page0-page1
		OLED_WR_Byte(0x00,0);		//low column start address
		OLED_WR_Byte(0x10,0);		//high column start address
		OLED_WR_Data(GRAM[page], 128);
	}
	return;
}

// initialize SSD1306					    
void OLED_Init(void)
{
	OLED_WR_Byte(0xAE,OLED_CMD);//--display off
	OLED_WR_Byte(0x00,OLED_CMD);//--set low column address
	OLED_WR_Byte(0x10,OLED_CMD);//--set high column address
	OLED_WR_Byte(0x40,OLED_CMD);//--set start line address  
	OLED_WR_Byte(0xB0,OLED_CMD);//--set page address
	OLED_WR_Byte(0x81,OLED_CMD);//--contract control
	OLED_WR_Byte(0xFF,OLED_CMD);//--128
	OLED_WR_Byte(0xA1,OLED_CMD);//--set segment remap 
	OLED_WR_Byte(0xA6,OLED_CMD);//--normal / reverse
	OLED_WR_Byte(0xA8,OLED_CMD);//--set multiplex ratio(1 to 64)
	OLED_WR_Byte(0x3F,OLED_CMD);//--1/32 duty
	OLED_WR_Byte(0xC8,OLED_CMD);//--Com scan direction
	OLED_WR_Byte(0xD3,OLED_CMD);//--set display offset
	OLED_WR_Byte(0x00,OLED_CMD);//
	
	OLED_WR_Byte(0xD5,OLED_CMD);//set osc division
	OLED_WR_Byte(0x80,OLED_CMD);//
	
	OLED_WR_Byte(0xD8,OLED_CMD);//set area color mode off
	OLED_WR_Byte(0x05,OLED_CMD);//
	
	OLED_WR_Byte(0xD9,OLED_CMD);//Set Pre-Charge Period
	OLED_WR_Byte(0xF1,OLED_CMD);//
	
	OLED_WR_Byte(0xDA,OLED_CMD);//set com pin configuartion
	OLED_WR_Byte(0x12,OLED_CMD);//
	
	OLED_WR_Byte(0xDB,OLED_CMD);//set Vcomh
	OLED_WR_Byte(0x30,OLED_CMD);//
	
	OLED_WR_Byte(0x8D,OLED_CMD);//set charge pump enable
	OLED_WR_Byte(0x14,OLED_CMD);//
	
	OLED_WR_Byte(0xAF,OLED_CMD);//--turn on oled panel
}  
